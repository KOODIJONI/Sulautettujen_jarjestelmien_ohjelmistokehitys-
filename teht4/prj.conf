## CMakeLists.txt
```
cmake_minimum_required(VERSION 3.20.0)

set(CMAKE_EXPORT_COMPILE_COMMANDS ON)
set(EXTRA_DTC_OVERLAY_FILES ${CMAKE_CURRENT_SOURCE_DIR}/app.overlay)

find_package(Zephyr REQUIRED HINTS $ENV{ZEPHYR_BASE})
project(teht2)

target_sources(app PRIVATE
    src/main.c
    src/leds.c
    src/dispatcher.c
    src/debug.c
)

target_include_directories(app PRIVATE include)
```

## prj.conf
```kconfig
CONFIG_SHELL=n
CONFIG_TIMING_FUNCTIONS=y
CONFIG_HEAP_MEM_POOL_SIZE=2048
```

## src/main.c
```c
#include <zephyr/kernel.h>
#include <zephyr/devicetree.h>
#include <zephyr/drivers/gpio.h>
#include <stdlib.h>
#include <assert.h>

#include "main.h"
#include "leds.h"
#include "dispatcher.h"
#include "debug.h"
//includet aina ekana

/*
Tehtävä 2 Joni Mäyrä
Sulautetun ohjelmoinnin kurssi

Pistevaatimus täydet pisteet koska tein tehtävässä vaadittavat asiat

1. Mikrosekuntien laskenta perus sekvenssistä ja väri säikeistä

2. Debug printtaus fifo taski

3. Debug togglaus ominaisuus 'D'

4. 4 assert kutsua lisätty


        .--.
       |o_o |
       |:_/ |
      //   \ \
     (|     | )
    /'\_   _/`\
    \___)=(___/

*/


//threadit 
#define STACK_SIZE 512
#define THREAD_PRIORITY 1

K_THREAD_DEFINE(red_tid, STACK_SIZE, red_led_thread, NULL, NULL, NULL, THREAD_PRIORITY, 0, 0);
K_THREAD_DEFINE(green_tid, STACK_SIZE, green_led_thread, NULL, NULL, NULL, THREAD_PRIORITY, 0, 0);
K_THREAD_DEFINE(yellow_tid, STACK_SIZE, yellow_led_thread, NULL, NULL, NULL, THREAD_PRIORITY, 0, 0);
K_THREAD_DEFINE(fifo_consumer_tid, STACK_SIZE, fifo_consumer_thread, NULL, NULL, NULL, THREAD_PRIORITY, 0, 0);
K_THREAD_DEFINE(sequence_tid, STACK_SIZE, sequence_thread, NULL, NULL, NULL, THREAD_PRIORITY, 0, 0);
//interrupt

//Mutexi ja conditional varit
K_MUTEX_DEFINE(sync_mutex);
K_CONDVAR_DEFINE(red_cond);
K_CONDVAR_DEFINE(green_cond);
K_CONDVAR_DEFINE(yellow_cond);

//semiforet
K_SEM_DEFINE(seq_sem, 0, 1);
K_SEM_DEFINE(release_sem,0,1);

//syötetyn valon delay
static volatile int active_delay;

static volatile bool sequence_active = false;

//T moodi puskuri
static command_t cmd_buffer[MAX_COMMANDS];
static size_t cmd_count = 0;

//pääohjelma
int main(void)
{
        
   
        // Init ledits
        if (leds_init() != 0) {
                return -1;
        }

        if (init_uart_dispatcher() != 0) {
                return -1;
        }


}

//punanen thredi
void red_led_thread(void *arg1, void *arg2, void *arg3)
{
        while (1) {

                k_mutex_lock(&sync_mutex, K_FOREVER);

                k_condvar_wait(&red_cond, &sync_mutex, K_FOREVER);
                int delay = active_delay;
                k_mutex_unlock(&sync_mutex);
                timing_task_start(RED_TIMING_DATA,"red_task");

                led_red_set(1);
                k_msleep(delay);
                led_red_set(0);

                timing_task_end(RED_TIMING_DATA);
                k_sem_give(&release_sem);
        }
}
// vihreä thredi
void green_led_thread(void *arg1, void *arg2, void *arg3)
{
        while (1) {
                k_mutex_lock(&sync_mutex, K_FOREVER);

                k_condvar_wait(&green_cond, &sync_mutex, K_FOREVER);
                int delay = active_delay;
                k_mutex_unlock(&sync_mutex);
                timing_task_start(GREEN_TIMING_DATA,"green_task");


                led_green_set(1);
                k_msleep(delay);
                led_green_set(0);

                timing_task_end(GREEN_TIMING_DATA);
                k_sem_give(&release_sem);
        }
}

//keltanen thredi
void yellow_led_thread(void *arg1, void *arg2, void *arg3)
{
        while (1) {
                k_mutex_lock(&sync_mutex, K_FOREVER);

                k_condvar_wait(&yellow_cond, &sync_mutex, K_FOREVER);
                int delay = active_delay;
                k_mutex_unlock(&sync_mutex);
                timing_task_start(YELLOW_TIMING_DATA,"yellow_task");

                led_yellow_set(1);
                k_msleep(delay);
                led_yellow_set(0);

                timing_task_end(YELLOW_TIMING_DATA);
                k_sem_give(&release_sem);
        }
}

static void execute_led_cmd(char color, int delay)
{
        k_mutex_lock(&sync_mutex, K_FOREVER);
        active_delay = delay;

        if (color == 'R' || color == 'r') {
                k_condvar_signal(&red_cond);
        } else if (color == 'G' || color == 'g') {
                k_condvar_signal(&green_cond);
        } else if (color == 'Y' || color == 'y') {
                k_condvar_signal(&yellow_cond);
        } else {
                k_mutex_unlock(&sync_mutex);
                return;
        }

        

        k_mutex_unlock(&sync_mutex);


        k_sem_take(&release_sem, K_FOREVER);
}

void sequence_thread(void *arg1, void *arg2, void *arg3)
{
    while (1) {
        k_sem_take(&seq_sem, K_FOREVER);
        //pyöritä sekvenssiä
        while (sequence_active && cmd_count > 0) {
                
                timing_task_start(SEQUENCE_TIMING_DATA,"Sequence Task");
                for (size_t i = 0; i < cmd_count; i++) {
                        if (!sequence_active) {
                        break; 
                        }
                        execute_led_cmd(cmd_buffer[i].color, cmd_buffer[i].delay);
                }
                timing_task_end(SEQUENCE_TIMING_DATA);
        }
    }
}

void fifo_consumer_thread(void *arg1, void *arg2, void *arg3)
{
    while (1) {
        struct data_t *buf = k_fifo_get(&dispatcher_fifo, K_FOREVER);
        if (buf != NULL) {

            timing_task_start(SERIAL_TIMING_DATA, "Serial Thread");

            char color = buf->msg[0];
            
            //parserointi
            char *comma = strchr(buf->msg, ',');
            int delay = (comma != NULL) ? atoi(comma + 1) : atoi(&buf->msg[2]);
            
            

            if (delay <= 0) {
                delay = 1000;
            }

            assert(delay>0);

            

            //Jos väri kirjai
            if (color == 'R' || color == 'r' || 
                color == 'G' || color == 'g' || 
                color == 'Y' || color == 'y') {

                // tallenna kometopuskurii
                k_mutex_lock(&sync_mutex, K_FOREVER);
                if (cmd_count < MAX_COMMANDS) {
                    cmd_buffer[cmd_count].color = color;
                    cmd_buffer[cmd_count].delay = delay;
                    cmd_count++;
                }
                k_mutex_unlock(&sync_mutex);

                //aja ledi 
                execute_led_cmd(color, delay);

                // Toisto
                } else if (color == 'T' || color == 't') {
                        if (!sequence_active && cmd_count > 0) {
                                sequence_active = true;
                                k_sem_give(&seq_sem);
                        }

                // Pysäytä skenvenssi
                } else if (color == 'C' || color == 'c') {
                        sequence_active = false;

                        k_mutex_lock(&sync_mutex, K_FOREVER);
                        cmd_count = 0;
                        k_mutex_unlock(&sync_mutex);
                }
                else if (color == 'D' || color == 'd'){
                        toggle_debug();
                }
                #ifdef DEBUG
                else{
                        assert(0);
                }
                #endif

            
                timing_task_end(SERIAL_TIMING_DATA);
                k_free(buf);
        }
    }
}
```

## include/buttons.h
```c
#ifndef BUTTONS_H
#define BUTTONS_H

#include <stdbool.h>

#define BUTTON1_NODE DT_ALIAS(sw0)
#define BUTTON2_NODE DT_ALIAS(sw1)
#define BUTTON3_NODE DT_ALIAS(sw2)
#define BUTTON4_NODE DT_ALIAS(sw3)
#define BUTTON5_NODE DT_ALIAS(sw4)

int buttons_init(void);        
bool button_was_pressed(int i);  

#endif
```

## include/debug.h
```c
#ifndef DEBUG_H_
#define DEBUG_H_

#include <zephyr/kernel.h>
#include <stdint.h>
#include <stdbool.h>

enum timing_data_type {
    RED_TIMING_DATA = 0,
    YELLOW_TIMING_DATA,
    GREEN_TIMING_DATA,
    SERIAL_TIMING_DATA,
    SEQUENCE_TIMING_DATA,
    CMD_TIMING_DATA,
    TIMING_TASK_COUNT
};

struct timing_data {
    void *fifo_reserved;        
    enum timing_data_type type; 
    const char *name;
    int64_t start_time;         
    int64_t end_time;           
    int64_t duration;           
};

extern bool debug_enabled;
extern struct k_fifo debug_info;
extern struct timing_data times[TIMING_TASK_COUNT];

void timing_task_start(enum timing_data_type task_type, const char *task_name);
void timing_task_end(enum timing_data_type task_type);
void toggle_debug();
bool get_debug();
void debug_fifo_thread_entry(void *p1, void *p2, void *p3);

#endif 
```

## include/dispatcher.h
```c
#ifndef DISPATCHER_H
#define DISPATCHER_H

#include <zephyr/kernel.h>

struct data_t {
    void *fifo_reserved;
    char msg[128];
};

extern struct k_fifo dispatcher_fifo;

int init_uart_dispatcher(void);

#endif
```

## include/main.h
```c
#ifndef MAIN_H
#define MAIN_H

void red_led_thread(void *arg1, void *arg2, void *arg3);
void green_led_thread(void *arg1, void *arg2, void *arg3);
void yellow_led_thread(void *arg1, void *arg2, void *arg3);
//void yellow_blink_thread(void *arg1, void *arg2, void *arg3);
//void pause_led_thread(void *arg1, void *arg2, void *arg3);
void fifo_consumer_thread(void *arg1, void *arg2, void *arg3);
void sequence_thread(void *arg1, void *arg2, void *arg3);

#define MAX_COMMANDS 32


typedef struct {
    char color;
    int delay;
} command_t;

enum led_states {
    RED = 0,
    GREEN = 1,
    YELLOW = 2,
    PAUSE = 4,
    RED_ON = 5,
    RED_GREEN_ON = 6,
    GREEN_ON = 7,
    YELLOW_BLINK = 8
};

#endif /* MAIN_H */
```

## src/debug.c
```c
#include "debug.h"
#include <zephyr/logging/log.h>
#include <assert.h>
LOG_MODULE_REGISTER(debug_timing, LOG_LEVEL_INF);

bool debug_enabled = true;
K_FIFO_DEFINE(debug_info);

struct timing_data times[TIMING_TASK_COUNT];

void timing_task_start(enum timing_data_type task_type, const char *task_name)
{
    if (task_type >= TIMING_TASK_COUNT) {
        return;
    }

    assert(task_type <=TIMING_TASK_COUNT);
    
    times[task_type].type = task_type;
    times[task_type].name = task_name;
    times[task_type].start_time = k_cycle_get_32();
}
void toggle_debug(){
    debug_enabled=!debug_enabled;
    if(debug_enabled) {
            printk("Debug on\n");
    }
    else{
            printk("Debug off\n");

    }
    
}
bool get_debug(){
    return debug_enabled;
}
void timing_task_end(enum timing_data_type task_type)
{
    if (task_type >= TIMING_TASK_COUNT) {
        return;
    }

    assert(task_type <=TIMING_TASK_COUNT);

    struct timing_data *data = &times[task_type];
    data->end_time  = k_cycle_get_32();
    data->duration =  k_cyc_to_us_floor32(data->end_time - data->start_time);

    if (debug_enabled) {
        k_fifo_put(&debug_info, data);
    }
}


void debug_fifo_thread_entry(void *p1, void *p2, void *p3)
{
    ARG_UNUSED(p1);
    ARG_UNUSED(p2);
    ARG_UNUSED(p3);

    printk("Debug timing FIFO processing thread started\n");

    while (1) {
        struct timing_data *item = k_fifo_get(&debug_info, K_FOREVER);

        if (item != NULL) {
            printk("Task [%s | ID:%d] executed in %lld us (Start: %lld cycle, End: %lld cycle)\n",
                item->name != NULL ? item->name : "UNKNOWN",
                item->type,
                item->duration,
                item->start_time,
                item->end_time);
        }
    }
}

K_THREAD_DEFINE(debug_fifo_tid, 1024,
                debug_fifo_thread_entry, NULL, NULL, NULL,
                5, 0, 0);
```

## src/dispatcher.c
```c
#include <zephyr/kernel.h>
#include <zephyr/sys/printk.h>
#include <zephyr/device.h>
#include <zephyr/drivers/uart.h>
#include <string.h>
#include <stdio.h>
#include <errno.h>

#include "dispatcher.h"

#define UART_DEVICE_NODE DT_CHOSEN(zephyr_shell_uart)

static const struct device *const uart_dev = DEVICE_DT_GET(UART_DEVICE_NODE);

K_FIFO_DEFINE(dispatcher_fifo);


/*
 * Alustetaan UART.
 */
int init_uart_dispatcher(void)
{
    if (!device_is_ready(uart_dev)) {
        printk("UART device not ready\n");
        return -ENODEV;
    }

    return 0;
}


/*
 * UART receiver task.
 *
 * Vastaanottaa esimerkiksi:
 *
 * R,1000\r
 * Y,500\r
 * G,1000\r
 *
 * ja laittaa jokaisen komennon dispatcher_fifoon
 * omana data_t-rakenteenaan.
 *
 * Myös pelkkä:
 *
 * RYGYRYG\r
 *
 * toimii.
 */
static void uart_task(void *u1, void *u2, void *u3)
{
    unsigned char rc;

    char seq_buf[128];
    size_t seq_len = 0;

    if (init_uart_dispatcher() != 0) {
        return;
    }

    printk("UART receiver started\n");

    while (true) {

        /*
         * Luetaan kaikki tällä hetkellä saatavilla olevat merkit.
         */
        while (uart_poll_in(uart_dev, &rc) == 0) {

            /*
             * CR ja LF tarkoittavat komennon loppua.
             */
            if (rc == '\r' || rc == '\n') {

                /*
                 * Jos puskuri sisältää komennon,
                 * tehdään siitä FIFO-alkio.
                 */
                if (seq_len > 0) {

                    seq_buf[seq_len] = '\0';

                    struct data_t *buf =
                        k_malloc(sizeof(struct data_t));

                    if (buf == NULL) {
                        seq_len = 0;
                        continue;
                    }

                    /*
                     * Kopioidaan komento FIFO-dataan.
                     */
                    snprintf(buf->msg,
                             sizeof(buf->msg),
                             "%s",
                             seq_buf);


                    k_fifo_put(&dispatcher_fifo, buf);

                    /*
                     * Aloitetaan seuraavan komennon vastaanotto.
                     */
                    seq_len = 0;
                    memset(seq_buf, 0, sizeof(seq_buf));
                }

                continue;
            }


            /*
             * Normaali merkki.
             */
            if (seq_len < sizeof(seq_buf) - 1) {

                seq_buf[seq_len++] = (char)rc;

            } else {

                /*
                 * Puskuri täynnä.
                 */

                seq_len = 0;
                memset(seq_buf, 0, sizeof(seq_buf));
            }
        }

        /*
         * Annetaan muille taskeille CPU-aikaa.
         */
        k_msleep(1);
    }
}


K_THREAD_DEFINE(
    uart_thread,
    1024,
    uart_task,
    NULL,
    NULL,
    NULL,
    5,
    0,
    0
);
```
